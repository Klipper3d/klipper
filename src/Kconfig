## src/lpc176x/Kconfig
```kconfig
# Kconfig settings for LPC176x processors

if MACH_LPC176X

config LPC_SELECT
    bool
    default y
    select HAVE_GPIO
    select HAVE_GPIO_ADC
    select HAVE_GPIO_I2C
    select HAVE_GPIO_SPI
    select HAVE_GPIO_HARD_PWM
    select HAVE_STRICT_TIMING
    select HAVE_CHIPID
    select HAVE_STEPPER_OPTIMIZED_BOTH_EDGE
    select HAVE_BOOTLOADER_REQUEST

config BOARD_DIRECTORY
    string
    default "lpc176x"

choice
    prompt "Processor model"
    config MACH_LPC1768
        bool "lpc1768 (100 MHz)"
    config MACH_LPC1769
        bool "lpc1769 (120 MHz)"
endchoice

config MCU
    string
    default "lpc1768" if MACH_LPC1768
    default "lpc1769" if MACH_LPC1769

config CLOCK_FREQ
    int
    default 100000000 if MACH_LPC1768
    default 120000000 if MACH_LPC1769

config FLASH_SIZE
    hex
    default 0x80000

config FLASH_BOOT_ADDRESS
    hex
    default 0x0

config RAM_START
    hex
    default 0x10000000

config RAM_SIZE
    hex
    default 0x7fe0 # (0x8000 - 32) - top 32 bytes used by IAP functions

config STACK_SIZE
    int
    default 512


######################################################################
# Bootloader
######################################################################

choice
    prompt "Bootloader offset"
    config LPC_FLASH_START_4000
        bool "16KiB bootloader"
    config LPC_FLASH_START_0000
        bool "No bootloader"
endchoice
config FLASH_APPLICATION_ADDRESS
    hex
    default 0x4000 if LPC_FLASH_START_4000
    default 0x0000


######################################################################
# Communication inteface
######################################################################

choice
    prompt "Communication interface"
    config LPC_USB
        bool "USB"
        select USBSERIAL
    config LPC_SERIAL_UART0_P03_P02
        bool "Serial (on UART0 P0.3/P0.2)"
        select SERIAL
    config LPC_SERIAL_UART3_P429_P428
        bool "Serial (on UART3 P4.29/P4.28)" if LOW_LEVEL_OPTIONS
        select SERIAL
    config LPC_MMENU_CANBUS_P0_0_P0_1
        bool "CAN bus (CAN1 on P0.0/P0.1)"
        select CANSERIAL
    config LPC_MMENU_CANBUS_P0_21_P0_22
        bool "CAN bus (CAN1 on P0.21/P0.22)" if LOW_LEVEL_OPTIONS
        select CANSERIAL
    config LPC_MMENU_CANBUS_P0_4_P0_5
        bool "CAN bus (CAN2 on P0.4/P0.5)" if LOW_LEVEL_OPTIONS
        select CANSERIAL
    config LPC_MMENU_CANBUS_P2_7_P2_8
        bool "CAN bus (CAN2 on P2.7/P2.8)" if LOW_LEVEL_OPTIONS
        select CANSERIAL
    config LPC_USBCANBUS
        bool "USB to CAN bus bridge" if LOW_LEVEL_OPTIONS
        select USBCANBUS
endchoice

choice
    prompt "CAN bus interface" if USBCANBUS
    config LPC_CMENU_CANBUS_P0_0_P0_1
        bool "CAN bus (CAN1 on P0.0/P0.1)"
    config LPC_CMENU_CANBUS_P0_21_P0_22
        bool "CAN bus (CAN1 on P0.21/P0.22)"
    config LPC_CMENU_CANBUS_P0_4_P0_5
        bool "CAN bus (CAN2 on P0.4/P0.5)"
    config LPC_CMENU_CANBUS_P2_7_P2_8
        bool "CAN bus (CAN2 on P2.7/P2.8)"
endchoice

config LPC_CANBUS_P0_0_P0_1
    bool
    default y if LPC_MMENU_CANBUS_P0_0_P0_1 || LPC_CMENU_CANBUS_P0_0_P0_1
config LPC_CANBUS_P0_21_P0_22
    bool
    default y if LPC_MMENU_CANBUS_P0_21_P0_22 || LPC_CMENU_CANBUS_P0_21_P0_22
config LPC_CANBUS_P0_4_P0_5
    bool
    default y if LPC_MMENU_CANBUS_P0_4_P0_5 || LPC_CMENU_CANBUS_P0_4_P0_5
config LPC_CANBUS_P2_7_P2_8
    bool
    default y if LPC_MMENU_CANBUS_P2_7_P2_8 || LPC_CMENU_CANBUS_P2_7_P2_8

endif
```

## src/lpc176x/t5uid1/Kconfig
```kconfig
# Kconfig T5UID1 settings for LPC176x processors

config T5UID1_SERIAL
    bool "Enable DGUS T5UID1 screen"
    default n

choice
    depends on T5UID1_SERIAL
    prompt "Screen Serial Port" if LOW_LEVEL_OPTIONS
    default LPC176X_T5UID1_SERIAL_UART3 if !USBSERIAL
    default LPC176X_T5UID1_SERIAL_UART0
    help
        Select the serial device to use for the touchscreen.
    config LPC176X_T5UID1_SERIAL_UART0
        bool "UART0" if USBSERIAL
    config LPC176X_T5UID1_SERIAL_UART1
        bool "UART1 (on P0.16/P0.15)"
    config LPC176X_T5UID1_SERIAL_UART3
        bool "UART3 (on P4.29/P4.28)"
endchoice

config T5UID1_SERIAL_PORT
    depends on T5UID1_SERIAL
    int
    default 3 if LPC176X_T5UID1_SERIAL_UART3
    default 1 if LPC176X_T5UID1_SERIAL_UART1
    default 0 if LPC176X_T5UID1_SERIAL_UART0
    default 3 if !USBSERIAL
    default 0
```

## src/pru/Kconfig
```kconfig
# Kconfig settings for PRU

if MACH_PRU

config PRU_SELECT
    bool
    default y
    select HAVE_GPIO
    #select HAVE_GPIO_ADC
    select HAVE_STRICT_TIMING
    select HAVE_LIMITED_CODE_SIZE

config BOARD_DIRECTORY
    string
    default "pru"

config CLOCK_FREQ
    int
    default 200000000

endif
```

## src/raspberrypi/Kconfig
```kconfig
# Kconfig settings for compiling and running the micro-controller code
# in a Linux process on a Raspberry Pi using memory-mapped IO rather
# than system calls.

if MACH_RASPBERRYPI

config RASPBERRYPI_SELECT
    bool
    default y
    select HAVE_GPIO

config BOARD_DIRECTORY
    string
    default "raspberrypi"

config CLOCK_FREQ
    int
    default 54000000

endif
```

## src/rp2040/Kconfig
```kconfig
# Kconfig settings for RPxxxx processors

if MACH_RPXXXX

config RPXXXX_SELECT
    bool
    default y
    select HAVE_GPIO
    select HAVE_GPIO_ADC
    select HAVE_GPIO_SPI
    select HAVE_GPIO_I2C
    select HAVE_STRICT_TIMING
    select HAVE_CHIPID
    select HAVE_GPIO_HARD_PWM
    select HAVE_STEPPER_OPTIMIZED_BOTH_EDGE
    select HAVE_BOOTLOADER_REQUEST
    # Software divide needed on rp2040 in spi rate, i2c rate, hard_pwm rate
    select HAVE_SOFTWARE_DIVIDE_REQUIRED if MACH_RP2040

config BOARD_DIRECTORY
    string
    default "rp2040"

######################################################################
# Chip selection
######################################################################

choice
    prompt "Processor model"
    config MACH_RP2040
        bool "rp2040"
    config MACH_RP2350
        bool "rp2350"
endchoice

config MCU
    string
    default "rp2040" if MACH_RP2040
    default "rp2350" if MACH_RP2350

config CLOCK_FREQ
    int
    default 12000000 if MACH_RP2040
    default 150000000 if MACH_RP2350

config FLASH_SIZE
    hex
    default 0x200000

config FLASH_BOOT_ADDRESS
    hex
    default 0x10000100 if MACH_RP2040 # Stage2 binary starts at 0x10000000
    default 0x10000000 if MACH_RP2350

config RAM_START
    hex
    default 0x20000000

config RAM_SIZE
    hex
    default 0x42000 if MACH_RP2040
    default 0x82000 if MACH_RP2350

config STACK_SIZE
    int
    default 512


######################################################################
# Bootloader options
######################################################################

config RP2040_HAVE_STAGE2
    bool
config RPXXXX_HAVE_BOOTLOADER
    bool

choice
    prompt "Bootloader offset"
    config RPXXXX_FLASH_START_0000
        bool "No bootloader"
        depends on MACH_RP2350
    config RPXXXX_FLASH_START_0100
        bool "No bootloader"
        depends on MACH_RP2040
        select RP2040_HAVE_STAGE2
    config RPXXXX_FLASH_START_4000
        bool "16KiB bootloader"
        select RPXXXX_HAVE_BOOTLOADER
endchoice
config FLASH_APPLICATION_ADDRESS
    hex
    default 0x10004000 if RPXXXX_FLASH_START_4000
    default 0x10000100 if RPXXXX_FLASH_START_0100
    default 0x10000000 if RPXXXX_FLASH_START_0000

choice
    prompt "Flash chip" if LOW_LEVEL_OPTIONS && RP2040_HAVE_STAGE2
    config RP2040_FLASH_W25Q080
        bool "W25Q080 with CLKDIV 2"
    config RP2040_FLASH_GENERIC_03
        bool "GENERIC_03H with CLKDIV 4"
endchoice

config RP2040_STAGE2_FILE
    string
    default "boot2_generic_03h.S" if RP2040_FLASH_GENERIC_03
    default "boot2_w25q080.S"

config RP2040_STAGE2_CLKDIV
    int
    default 4 if RP2040_FLASH_GENERIC_03
    default 2


######################################################################
# Communication inteface
######################################################################

choice
    prompt "Communication Interface"
    config RPXXXX_USB
        bool "USBSERIAL"
        select USBSERIAL
    config RPXXXX_SERIAL_UART0_PINS_0_1
        bool "UART0 on GPIO0/GPIO1"
        select SERIAL
    config RPXXXX_SERIAL_UART0_PINS_12_13
        bool "UART0 on GPIO12/GPIO13" if LOW_LEVEL_OPTIONS
        select SERIAL
    config RPXXXX_SERIAL_UART0_PINS_16_17
        bool "UART0 on GPIO16/GPIO17" if LOW_LEVEL_OPTIONS
        select SERIAL
    config RPXXXX_SERIAL_UART0_PINS_28_29
        bool "UART0 on GPIO28/GPIO29" if LOW_LEVEL_OPTIONS
        select SERIAL
    config RPXXXX_SERIAL_UART1_PINS_4_5
        bool "UART1 on GPIO4/GPIO5" if LOW_LEVEL_OPTIONS
        select SERIAL
    config RPXXXX_SERIAL_UART1_PINS_8_9
        bool "UART1 on  GPIO8/GPIO9" if LOW_LEVEL_OPTIONS
        select SERIAL
    config RPXXXX_SERIAL_UART1_PINS_20_21
        bool "UART1 on  GPIO20/GPIO21" if LOW_LEVEL_OPTIONS
        select SERIAL
    config RPXXXX_SERIAL_UART1_PINS_24_25
        bool "UART1 on GPIO24/GPIO25"  if LOW_LEVEL_OPTIONS
        select SERIAL
    config RPXXXX_CANBUS
        bool "CAN bus"
        select CANSERIAL
    config RPXXXX_USBCANBUS
        bool "USB to CAN bus bridge"
        select USBCANBUS
endchoice

config RPXXXX_CANBUS_GPIO_RX
    int "CAN RX gpio number" if CANBUS
    default 4
    range 0 29

config RPXXXX_CANBUS_GPIO_TX
    int "CAN TX gpio number" if CANBUS
    default 5
    range 0 29

endif
```

## src/sam3/Kconfig
```kconfig
# Kconfig settings for SAM3/SAM4 processors

if MACH_SAM3

config SAM3_SELECT
    bool
    default y
    select HAVE_GPIO
    select HAVE_GPIO_ADC
    select HAVE_GPIO_I2C
    select HAVE_GPIO_SPI
    select HAVE_GPIO_BITBANGING

config BOARD_DIRECTORY
    string
    default "sam3"

choice
    prompt "Processor model"
    config MACH_SAM3X8E
        bool "SAM3x8e (Arduino Due)"
    config MACH_SAM4S8C
        bool "SAM4s8c (Duet Maestro)"
    config MACH_SAM4E8E
        bool "SAM4e8e (Duet Wifi/Eth)"
endchoice

config MCU
    string
    default "sam3x8e" if MACH_SAM3X8E
    default "sam4s8c" if MACH_SAM4S8C
    default "sam4e8e" if MACH_SAM4E8E

config CLOCK_FREQ
    int
    default 42000000 if MACH_SAM3X8E # 84000000/2
    default 15000000 if MACH_SAM4S8C # 120000000/8
    default 60000000 if MACH_SAM4E8E # 120000000/2

config USBSERIAL
    depends on MACH_SAM4S8C || MACH_SAM4E8E
    bool "Use USB for communication (instead of serial)"
    default y
config SERIAL
    depends on !USBSERIAL
    bool
    default y
config SERIAL_BAUD
    depends on SERIAL
    int "Baud rate for serial port"
    default 250000

endif
```

## src/sam3x8e/Kconfig
```kconfig
# Kconfig settings for SAM3x8e processors

if MACH_SAM3X8E

config SAM_SELECT
    bool
    default y
    select HAVE_GPIO
    select HAVE_GPIO_ADC
    select HAVE_GPIO_SPI
    select HAVE_GPIO_BITBANGING

config BOARD_DIRECTORY
    string
    default "sam3x8e"

config CLOCK_FREQ
    int
    default 42000000 # 84000000/2

config SERIAL
    bool
    default y
config SERIAL_BAUD
    depends on SERIAL
    int "Baud rate for serial port"
    default 250000

endif
```

## src/sam4e8e/Kconfig
```kconfig
# Kconfig settings for SAM4e8e processors

if MACH_SAM4E8E

config SAM_SELECT
    bool
    default y
    select HAVE_GPIO
    select HAVE_GPIO_I2C
    select HAVE_GPIO_ADC
    select HAVE_GPIO_SPI
    select HAVE_GPIO_BITBANGING

config BOARD_DIRECTORY
    string
    default "sam4e8e"

config CLOCK_FREQ
    int
    default 60000000 # 120000000/2

config SERIAL
    bool
    default y
config SERIAL_BAUD
    depends on SERIAL
    int "Baud rate for serial port"
    default 250000

endif
```
