## src/configs/K1_noz0_110_S06_defconfig
```kconfig
CONFIG_BOARD_INFO_CONFIGURE=y

#
# Board Configure
#
# CONFIG_MAIN_MCU_BOARD is not set
CONFIG_NOZZLE_MCU_BOARD=y
# CONFIG_BED_MCU_BOARD is not set
CONFIG_MCU_BOARD_ID=0
CONFIG_MCU_BOARD_HW_VER=110
CONFIG_MCU_BOARD_FW_VER=000
CONFIG_MCU_BOARD_FW_RESERVED=000
# end of Board Configure

CONFIG_LOW_LEVEL_OPTIONS=y
# CONFIG_MACH_AVR is not set
# CONFIG_MACH_ATSAM is not set
# CONFIG_MACH_ATSAMD is not set
# CONFIG_MACH_LPC176X is not set
CONFIG_MACH_STM32=y
# CONFIG_MACH_RP2040 is not set
# CONFIG_MACH_AT32 is not set
# CONFIG_MACH_GD32 is not set
# CONFIG_MACH_PRU is not set
# CONFIG_MACH_LINUX is not set
# CONFIG_MACH_SIMU is not set
CONFIG_BOARD_DIRECTORY="stm32"
CONFIG_MCU="stm32g071xx"
CONFIG_CLOCK_FREQ=64000000
CONFIG_SERIAL=y
CONFIG_FLASH_SIZE=0x20000
CONFIG_FLASH_BOOT_ADDRESS=0x8000000
CONFIG_RAM_START=0x20000000
CONFIG_RAM_SIZE=0x9000
CONFIG_STACK_SIZE=512
CONFIG_FLASH_APPLICATION_ADDRESS=0x8003000
CONFIG_STM32_SELECT=y
# CONFIG_MACH_STM32F103 is not set
# CONFIG_MACH_STM32F207 is not set
# CONFIG_MACH_STM32F401 is not set
# CONFIG_MACH_STM32F405 is not set
# CONFIG_MACH_STM32F407 is not set
# CONFIG_MACH_STM32F429 is not set
# CONFIG_MACH_STM32F446 is not set
# CONFIG_MACH_STM32F030 is not set
# CONFIG_MACH_STM32F031 is not set
# CONFIG_MACH_STM32F042 is not set
# CONFIG_MACH_STM32F070 is not set
# CONFIG_MACH_STM32F072 is not set
# CONFIG_MACH_STM32G0B0 is not set
# CONFIG_MACH_STM32G0B1 is not set
CONFIG_MACH_STM32G071=y
# CONFIG_MACH_STM32G431 is not set
# CONFIG_MACH_STM32H723 is not set
# CONFIG_MACH_STM32H743 is not set
# CONFIG_MACH_STM32H750 is not set
# CONFIG_MACH_STM32L412 is not set
CONFIG_MCU_TYPE="06"
CONFIG_MACH_STM32G0=y
CONFIG_STM32_DFU_ROM_ADDRESS=0
# CONFIG_STM32_FLASH_START_2000 is not set
CONFIG_STM32_FLASH_START_3000=y
# CONFIG_STM32_FLASH_START_0000 is not set
CONFIG_STM32_CLOCK_REF_8M=y
# CONFIG_STM32_CLOCK_REF_12M is not set
# CONFIG_STM32_CLOCK_REF_16M is not set
# CONFIG_STM32_CLOCK_REF_20M is not set
# CONFIG_STM32_CLOCK_REF_25M is not set
# CONFIG_STM32_CLOCK_REF_INTERNAL is not set
CONFIG_CLOCK_REF_FREQ=8000000
CONFIG_STM32F0_TRIM=16
# CONFIG_STM32_SERIAL_USART1 is not set
# CONFIG_STM32_SERIAL_USART1_ALT_PB7_PB6 is not set
CONFIG_STM32_SERIAL_USART2=y
# CONFIG_STM32_SERIAL_USART2_ALT_PD6_PD5 is not set
# CONFIG_STM32_SERIAL_USART3 is not set
# CONFIG_STM32_SERIAL_USART3_ALT_PD9_PD8 is not set
CONFIG_MCU_MENU="S"
CONFIG_SERIAL_BOOTLOADER_SIDECHANNEL=y
CONFIG_SERIAL_BAUD=230400
CONFIG_USB_VENDOR_ID=0x1d50
CONFIG_USB_DEVICE_ID=0x614e
CONFIG_USB_SERIAL_NUMBER="12345"
CONFIG_CANBUS_FREQUENCY=500000
CONFIG_MACH_CREALITY_OTHERS=y
# CONFIG_MACH_CREALITY_CR_10_SMART is not set
CONFIG_INITIAL_PINS="!PB14,!PB15,!PA8"
CONFIG_BUILD_MACHINE_UID=""
CONFIG_HAVE_GPIO=y
CONFIG_HAVE_GPIO_ADC=y
CONFIG_HAVE_PRTOUCH=y
CONFIG_HAVE_GPIO_SPI=y
CONFIG_HAVE_GPIO_I2C=y
CONFIG_HAVE_GPIO_HARD_PWM=y
CONFIG_HAVE_GPIO_BITBANGING=y
CONFIG_HAVE_STRICT_TIMING=y
CONFIG_HAVE_CHIPID=y
CONFIG_HAVE_STEPPER_BOTH_EDGE=y
CONFIG_INLINE_STEPPER_HACK=y
```

## src/configs/K1_noz0_120_G30_defconfig
```kconfig
CONFIG_BOARD_INFO_CONFIGURE=y

#
# Board Configure
#
# CONFIG_MAIN_MCU_BOARD is not set
CONFIG_NOZZLE_MCU_BOARD=y
# CONFIG_BED_MCU_BOARD is not set
CONFIG_MCU_BOARD_ID=0
CONFIG_MCU_BOARD_HW_VER=120
CONFIG_MCU_BOARD_FW_VER=003
CONFIG_MCU_BOARD_FW_RESERVED=000
# end of Board Configure

CONFIG_LOW_LEVEL_OPTIONS=y
# CONFIG_MACH_AVR is not set
# CONFIG_MACH_ATSAM is not set
# CONFIG_MACH_ATSAMD is not set
# CONFIG_MACH_LPC176X is not set
# CONFIG_MACH_STM32 is not set
# CONFIG_MACH_RP2040 is not set
# CONFIG_MACH_AT32 is not set
CONFIG_MACH_GD32=y
# CONFIG_MACH_PRU is not set
# CONFIG_MACH_LINUX is not set
# CONFIG_MACH_SIMU is not set
CONFIG_BOARD_DIRECTORY="gd32"
CONFIG_MCU="gd32f303xb"
CONFIG_CLOCK_FREQ=120000000
CONFIG_SERIAL=y
CONFIG_FLASH_SIZE=0x00020000
CONFIG_FLASH_BOOT_ADDRESS=0x8000000
CONFIG_RAM_START=0x20000000
CONFIG_RAM_SIZE=0x8000
CONFIG_STACK_SIZE=512
CONFIG_FLASH_APPLICATION_ADDRESS=0x8003000
CONFIG_MCU_TYPE="30"
CONFIG_GD32_SELECT=y
CONFIG_MACH_GD32F303XB=y
# CONFIG_MACH_GD32F303XC is not set
# CONFIG_MACH_GD32F303XE is not set
# CONFIG_MACH_GD32F303XG is not set
# CONFIG_MACH_GD32F303XI is not set
# CONFIG_MACH_GD32F303XK is not set
# CONFIG_MACH_GD32F305XB is not set
# CONFIG_MACH_GD32F305XC is not set
# CONFIG_MACH_GD32F305XE is not set
# CONFIG_MACH_GD32F305XG is not set
# CONFIG_MACH_GD32F307XC is not set
# CONFIG_MACH_GD32F307XE is not set
# CONFIG_MACH_GD32F307XG is not set
# CONFIG_MACH_GD32E230X6 is not set
# CONFIG_MACH_GD32E230X8 is not set
CONFIG_MACH_GD32F30X_HD=y
CONFIG_MACH_GD32F303XX=y
CONFIG_MACH_GD32F30X=y
# CONFIG_GD32_FLASH_START_0000 is not set
CONFIG_GD32_FLASH_START_3000=y
# CONFIG_GD32_SERIAL_USART0_PA9_PA10 is not set
CONFIG_GD32_SERIAL_USART1_PA2_PA3=y
# CONFIG_GD32_USB is not set
CONFIG_MCU_MENU="G"
CONFIG_SERIAL_BAUD=230400
CONFIG_USB_VENDOR_ID=0x1d50
CONFIG_USB_DEVICE_ID=0x614e
CONFIG_USB_SERIAL_NUMBER="12345"
CONFIG_CANBUS_FREQUENCY=500000
CONFIG_MACH_CREALITY_OTHERS=y
# CONFIG_MACH_CREALITY_CR_10_SMART is not set
CONFIG_INITIAL_PINS="!PB5,!PB6,!PB7"
CONFIG_BUILD_MACHINE_UID=""
CONFIG_HAVE_GPIO=y
CONFIG_HAVE_GPIO_ADC=y
CONFIG_HAVE_PRTOUCH=y
CONFIG_HAVE_GPIO_SPI=y
CONFIG_HAVE_GPIO_BITBANGING=y
CONFIG_HAVE_STRICT_TIMING=y
CONFIG_HAVE_CHIPID=y
CONFIG_HAVE_STEPPER_BOTH_EDGE=y
CONFIG_INLINE_STEPPER_HACK=y
```

## src/configs/Kconfig
```kconfig
config BOARD_INFO_CONFIGURE
    bool "Board info configure"
    depends on MACH_GD32
    default n
    help
        Enable board info configure, we can update mcu firmware
        by Linux with uart port.

menu "Board Configure"
    depends on BOARD_INFO_CONFIGURE
    choice
    prompt "Board Type"
        config MAIN_MCU_BOARD
            bool "Main MCU"
        config NOZZLE_MCU_BOARD
            bool "Nozzle MCU"
        config BED_MCU_BOARD
            bool "Bed MCU"
    endchoice

    config MCU_BOARD_ID
        int "MCU Board ID"
        default 0

    config MCU_BOARD_HW_VER
        int "HW Version"
        default 000

    config MCU_BOARD_FW_VER
        int "FW Version"
        default 000

    config MCU_BOARD_FW_RESERVED
        int "FW Reserved"
        default 000

endmenu
```

## src/esp32/Kconfig
```kconfig
# Kconfig settings for ESP32

if MACH_ESPRESSIF_ESP32

config ESP32_SELECT
    bool
    default y
    # @todo: actually implement this on FW
    select HAVE_GPIO
    #select HAVE_GPIO_ADC
    #select HAVE_GPIO_SPI
    #select HAVE_GPIO_I2C
    #select HAVE_GPIO_HARD_PWM
    #select HAVE_CHIPID

config BOARD_DIRECTORY
    string
    default "esp32"

choice
    prompt "Processor model (IDF target)"
    default MACH_esp32
    
	config MACH_esp32
		bool "esp32"
	config MACH_esp32s2
		bool "esp32s2"
	config MACH_esp32c3
		bool "esp32c3"
	config MACH_esp32s3
		bool "esp32s3"
	config MACH_esp32c2
		bool "esp32c2"
	config MACH_esp32c6
		bool "esp32c6"
	config MACH_esp32h2
		bool "esp32h2"
	config MACH_esp32p4
		bool "esp32p4"
	config MACH_esp32c5
		bool "esp32c5"
	config MACH_esp32c61
		bool "esp32c61"
	config MACH_esp_linux
		bool "linux"
	config MACH_esp32h21
		bool "esp32h21"
	config MACH_esp32h4
	    bool "esp32h4"
endchoice

config MCU
    string
	default "esp32" if MACH_esp32
	default "esp32s2" if MACH_esp32s2
	default "esp32c3" if MACH_esp32c3
	default "esp32s3" if MACH_esp32s3
	default "esp32c2" if MACH_esp32c2
	default "esp32c6" if MACH_esp32c6
	default "esp32h2" if MACH_esp32h2
	default "esp32p4" if MACH_esp32p4
	default "esp32c5" if MACH_esp32c5
	default "esp32c61" if MACH_esp32c61
	default "linux" if MACH_esp_linux
	default "esp32h21" if MACH_esp32h21
	default "esp32h4" if MACH_esp32h4

config CLOCK_FREQ
    int "Timer frequency (in Hz)"
    default 10000000
    help
        The frequency of the hardware timer used for scheduling

# INTERNAL
config USB_HAS_CDC
    bool
    default y if (MCU = "esp32s3")

# Communication interface
config USBSERIAL
    depends on USB_HAS_CDC
    bool
    default y
config SERIAL
    depends on !USBSERIAL
    bool
    default y

choice
    prompt "Communication interface" if LOW_LEVEL_OPTIONS
    default ESP32_SERIAL_UART

    config ESP32_SERIAL_UART
        bool "UART"

    config ESP32_SERIAL_USB_CDC
        depends on USBSERIAL
        bool "USB CDC"
endchoice

# UART Console Configuration
menu "UART Console Settings"
    depends on ESP32_SERIAL_UART

    config UART_TX_PIN
        int "UART TX Pin"
        range 0 48
        default 14
        help
            GPIO pin for UART TX (default: GPIO 1)

    config UART_RX_PIN
        int "UART RX Pin"
        range 0 48
        default 12
        help
            GPIO pin for UART RX (default: GPIO 3)
endmenu

config HAVE_GPIO_SR
    bool "Enable shift register output (HC595 and similar)"
    default n

# Todo use actual pins on boards
menu "Shift register output configuration"
    depends on HAVE_GPIO_SR

    config SR_BYTE_NO
        int "Shift register count (8 bits each)"
        range 1 16
        default 4
    config SR_CLOCK_FREQ_MHZ
        int "Clock frequency (MHz)"
        range 1 10
        default 10
    config SR_PIN_DATA
        int "Data pin"
        range 0 48
        default 5
    config SR_PIN_CLK
        int "Clock pin"
        range 0 48
        default 6
    config SR_PIN_LATCH
        int "Latch pin"
        range 0 48
        default 7
endmenu

endif
```

## src/esp32/sdkconfig.defaults
```kconfig
CONFIG_FREERTOS_UNICORE=y
CONFIG_FREERTOS_USE_TRACE_FACILITY=y
CONFIG_FREERTOS_USE_STATS_FORMATTING_FUNCTIONS=y
CONFIG_FREERTOS_VTASKLIST_INCLUDE_COREID=y
# Can't really disable preemption so
# Can I disable preemption?
# Can I disable idle task?
CONFIG_GPTIMER_ISR_HANDLER_IN_IRAM=y
CONFIG_GPTIMER_CTRL_FUNC_IN_IRAM=y
CONFIG_GPIO_CTRL_FUNC_IN_IRAM=y
CONFIG_ESP_DEFAULT_CPU_FREQ_MHZ_240=y
CONFIG_COMPILER_OPTIMIZATION_PERF=y
```

## src/hc32f460/Kconfig
```kconfig
# Kconfig settings for Huada HC32F460 processor

if MACH_HC32F460

config HC32F460_SELECT
    bool
    default y
    select HAVE_GPIO
    select HAVE_GPIO_ADC
    select HAVE_STRICT_TIMING
    select HAVE_GPIO_HARD_PWM
    select HAVE_STEPPER_OPTIMIZED_BOTH_EDGE
    # Software divide used by Huada SDK
    select HAVE_SOFTWARE_DIVIDE_REQUIRED

config BOARD_DIRECTORY
    string
    default "hc32f460"


######################################################################
# Communication interface
######################################################################
choice
    prompt "Communication interface"
    config HC32F460_SERIAL_PA7_PA8
        bool "Serial (PA7 & PA8)"
        select SERIAL
    config HC32F460_SERIAL_PA13_PA14
        bool "Serial (PA13 & PA14)"
        select SERIAL
    config HC32F460_SERIAL_PA3_PA2
        bool "Serial (PA3 & PA2)"
        select SERIAL
    config HC32F460_SERIAL_PH2_PB10
        bool "Serial (PH2 & PB10)"
        select SERIAL
    config HC32F460_SERIAL_PA15_PA9
        bool "Serial (PA15 & PA09)"
        select SERIAL
    config HC32F460_SERIAL_PC0_PC1
        bool "Serial (PC0 & PC1)"
        select SERIAL
endchoice

######################################################################
# Bootloader
# bootloader moves code and then VTOR.RESET points here:
######################################################################
config FLASH_SIZE
    hex
    default 0x40000

choice "Application Address"
    prompt "Application Address"
    config HC32F460_FLASH_APPLICATION_ADDRESS_0x008000
        bool "0x008000"
    config HC32F460_FLASH_APPLICATION_ADDRESS_0x00C000
        bool "0x00C000"
    config HC32F460_FLASH_APPLICATION_ADDRESS_0x010000
        bool "0x010000"
endchoice

config FLASH_APPLICATION_ADDRESS
    hex
    default 0x008000 if HC32F460_FLASH_APPLICATION_ADDRESS_0x008000
    default 0x00C000 if HC32F460_FLASH_APPLICATION_ADDRESS_0x00C000
    default 0x010000 if HC32F460_FLASH_APPLICATION_ADDRESS_0x010000

config FLASH_BOOT_ADDRESS
    hex
    default 0x0

config RAM_SIZE
    hex
    default 0x8000

# use the fast RAM in the HC32F460
config RAM_START
    hex
    default 0x1fff8000

config STACK_SIZE
    int
    default 1024

choice "Clock Speed"
    prompt "Clock Speed"
    config HC32F460_CLOCK_SPEED_168M
        bool "168 MHz"
    config HC32F460_CLOCK_SPEED_200M
        bool "200 MHz"
endchoice

config CLOCK_FREQ
    int
    default 200000000 if HC32F460_CLOCK_SPEED_200M
    default 168000000 if HC32F460_CLOCK_SPEED_168M

config MCU
    string
    default "HC32F460"

endif
```

## src/lgt/Kconfig
```kconfig
# Kconfig settings for LogicGreen processors

if MACH_LGT

config LGT_SELECT
    bool
    default y
    select HAVE_GPIO
    select HAVE_GPIO_ADC
    select HAVE_GPIO_SPI
    select HAVE_GPIO_I2C
    select HAVE_GPIO_HARD_PWM
    select HAVE_STRICT_TIMING
    select HAVE_LIMITED_CODE_SIZE

config BOARD_DIRECTORY
    string
    default "lgt"

choice
    prompt "Processor model"
    config MACH_lgtf328p
        bool "lgtf328p"
endchoice

config MCU
    string
    default "lgtf328p" if MACH_lgtf328p

config AVRDUDE_PROTOCOL
    string
    default "arduino"

choice
    prompt "Processor speed"
    config LGT_FREQ_32000000
        bool "32Mhz"
    config LGT_FREQ_16000000
        bool "16Mhz"
endchoice

config CLOCK_FREQ
    int
    default 32000000 if LGT_FREQ_32000000
    default 16000000

config LGT_STACK_SIZE
    int
    default 256

config LGT_WATCHDOG
    bool
    default y

config SERIAL
    bool
    default y

config SERIAL_BAUD_U2X
    depends on SERIAL
    bool
    default y

choice
    prompt "Baud rate for serial port"
    config LGT_SERIAL_BAUD_115200
        bool "115200"
    config LGT_SERIAL_BAUD_250000
        bool "250000"
endchoice

config SERIAL_BAUD
    int
    default 250000 if LGT_SERIAL_BAUD_250000
    default 115200

config SERIAL_PORT
    int
    default 0
endif
```

## src/linux/Kconfig
```kconfig
# Kconfig settings for compiling and running the micro-controller code
# in a Linux process

if MACH_LINUX

config LINUX_SELECT
    bool
    default y
    select HAVE_GPIO
    select HAVE_GPIO_ADC
    select HAVE_GPIO_SPI
    select HAVE_GPIO_I2C
    select HAVE_GPIO_HARD_PWM

config BOARD_DIRECTORY
    string
    default "linux"

config CLOCK_FREQ
    int
    default 50000000

config WIRINGPI
    bool "Use wiringPi"
    default n
    depends on HAVE_GPIO
    help
        Gpio control with wiringPi API.
        Unlike conventional methods of opening files and requesting R/W operations,
        it is a method of putting values directly into memory mapped in mmap.
        It will improve speed.

        Require some packages.
        [libwiringpi2], [libwiringpi-dev] is required.
        In other words, wiringPi must be supported for use it.

endif
```
