## src/atsamd/Kconfig
```kconfig
# Kconfig settings for Atmel SAMD processors

if MACH_ATSAMD

config ATSAMD_SELECT
    bool
    default y
    select HAVE_GPIO
    select HAVE_GPIO_ADC
    select HAVE_GPIO_I2C
    select HAVE_GPIO_SPI
    select HAVE_GPIO_HARD_PWM if MACH_SAMX2
    select HAVE_STRICT_TIMING
    select HAVE_CHIPID
    select HAVE_STEPPER_OPTIMIZED_BOTH_EDGE
    select HAVE_BOOTLOADER_REQUEST
    select HAVE_LIMITED_CODE_SIZE if FLASH_SIZE < 0x10000
    # Software divide needed to convert rate to baud in spi.c
    select HAVE_SOFTWARE_DIVIDE_REQUIRED if MACH_SAMD21

config HAVE_SERCOM
    depends on HAVE_GPIO_I2C || HAVE_GPIO_SPI
    bool
    default y

config BOARD_DIRECTORY
    string
    default "atsamd"

choice
    prompt "Processor model"
    config MACH_SAMC21G18
        bool "SAMC21G18"
        select MACH_SAMC21
    config MACH_SAMD21G18
        bool "SAMD21G18"
        select MACH_SAMD21
    config MACH_SAMD21E18
        bool "SAMD21E18"
        select MACH_SAMD21
    config MACH_SAMD21J18
        bool "SAMD21J18"
        select MACH_SAMD21
    config MACH_SAMD21E15
        bool "SAMD21E15"
        select MACH_SAMD21
    config MACH_SAMD51G19
        bool "SAMD51G19"
        select MACH_SAMD51
    config MACH_SAMD51J19
        bool "SAMD51J19"
        select MACH_SAMD51
    config MACH_SAMD51N19
        bool "SAMD51N19"
        select MACH_SAMD51
    config MACH_SAMD51P20
        bool "SAMD51P20"
        select MACH_SAMD51
    config MACH_SAME51J19
        bool "SAME51J19"
        select MACH_SAME51
    config MACH_SAME51N19
        bool "SAME51N19"
        select MACH_SAME51
    config MACH_SAME54P20
        bool "SAME54P20"
        select MACH_SAME54
endchoice

config MACH_SAMX2
    bool
config MACH_SAMC21
    bool
    select MACH_SAMX2
config MACH_SAMD21
    bool
    select MACH_SAMX2
config MACH_SAMX5
    bool
config MACH_SAMD51
    bool
    select MACH_SAMX5
config MACH_SAME51
    bool
    select MACH_SAMX5
config MACH_SAME54
    bool
    select MACH_SAMX5
config HAVE_SAMD_CANBUS
    bool
    default y if MACH_SAMC21 || MACH_SAME51 || MACH_SAME54
config HAVE_SAMD_USB
    bool
    default n if MACH_SAMC21G18
    default y

config MCU
    string
    default "samc21g18a" if MACH_SAMC21G18
    default "samd21g18a" if MACH_SAMD21G18
    default "samd21e18a" if MACH_SAMD21E18
    default "samd21j18a" if MACH_SAMD21J18
    default "samd21e15a" if MACH_SAMD21E15
    default "samd51g19a" if MACH_SAMD51G19
    default "samd51j19a" if MACH_SAMD51J19
    default "samd51n19a" if MACH_SAMD51N19
    default "samd51p20a" if MACH_SAMD51P20
    default "same51j19a" if MACH_SAME51J19
    default "same51n19a" if MACH_SAME51N19
    default "same54p20a" if MACH_SAME54P20

config FLASH_SIZE
    hex
    default 0x8000 if MACH_SAMD21E15
    default 0x40000 if MACH_SAMC21G18 || MACH_SAMD21G18 || MACH_SAMD21E18 || MACH_SAMD21J18
    default 0x80000 if MACH_SAMD51G19 || MACH_SAMD51J19 || MACH_SAMD51N19 || MACH_SAME51J19 || MACH_SAME51N19
    default 0x100000 if MACH_SAMD51P20 || MACH_SAME54P20

config FLASH_BOOT_ADDRESS
    hex
    default 0x0

config RAM_START
    hex
    default 0x20000000

config RAM_SIZE
    hex
    default 0x1000 if MACH_SAMD21E15
    default 0x8000 if MACH_SAMC21G18 ||  MACH_SAMD21G18 || MACH_SAMD21E18 || MACH_SAMD21J18
    default 0x30000 if MACH_SAMD51G19 || MACH_SAMD51J19 || MACH_SAMD51N19 || MACH_SAME51J19 || MACH_SAME51N19
    default 0x40000 if MACH_SAMD51P20 || MACH_SAME54P20

config STACK_SIZE
    int
    default 512


######################################################################
# Bootloader
######################################################################

choice
    prompt "Bootloader offset"
    config SAMD_FLASH_START_2000
        depends on MACH_SAMD21
        bool "8KiB bootloader"
    config SAMD_FLASH_START_4000
        bool "16KiB bootloader"
    config SAMD_FLASH_START_0000
        bool "No bootloader"
endchoice
config FLASH_APPLICATION_ADDRESS
    hex
    default 0x4000 if SAMD_FLASH_START_4000
    default 0x2000 if SAMD_FLASH_START_2000
    default 0x0000


######################################################################
# Clock
######################################################################

choice
    prompt "Clock Reference"
    config CLOCK_REF_X32K
        bool "32.768Khz crystal" if !MACH_SAMC21
    config CLOCK_REF_X12M
        bool "12Mhz crystal" if MACH_SAMC21
    config CLOCK_REF_X25M
        bool "25Mhz crystal" if MACH_SAMC21 || MACH_SAMX5
    config CLOCK_REF_INTERNAL
        bool "Internal clock" if !MACH_SAMC21
endchoice

choice
    depends on MACH_SAMX5 && LOW_LEVEL_OPTIONS
    prompt "Processor speed"
    config SAMD51_FREQ_120
        bool "120 MHz (standard)"
    config SAMD51_FREQ_150
        bool "150 MHz (overclock)"
    config SAMD51_FREQ_180
        bool "180 MHz (overclock)"
    config SAMD51_FREQ_200
        bool "200 MHz (overclock)"
endchoice

config CLOCK_FREQ
    int
    default 48000000 if MACH_SAMX2
    default 150000000 if SAMD51_FREQ_150
    default 180000000 if SAMD51_FREQ_180
    default 200000000 if SAMD51_FREQ_200
    default 120000000 if MACH_SAMX5


######################################################################
# Communication inteface
######################################################################

choice
    prompt "Communication interface"
    config ATSAMD_USB
        bool "USB"
        depends on HAVE_SAMD_USB
        select USBSERIAL
    config ATSAMD_SERIAL
        bool "Serial"
        depends on !MACH_SAMC21
        select SERIAL
    config ATSAMD_MMENU_CANBUS_PA23_PA22
        bool "CAN bus (on PA23/PA22)"
        depends on HAVE_SAMD_CANBUS
        select CANSERIAL
    config ATSAMD_MMENU_CANBUS_PA25_PA24
        bool "CAN bus (on PA25/PA24)"
        depends on HAVE_SAMD_CANBUS
        select CANSERIAL
    config ATSAMD_MMENU_CANBUS_PB11_PB10
        bool "CAN bus (on PB11/PB10)"
        depends on HAVE_SAMD_CANBUS && MACH_SAMC21
        select CANSERIAL
    config ATSAMD_MMENU_CANBUS_PB13_PB12
        bool "CAN bus (on PB13/PB12)"
        depends on HAVE_SAMD_CANBUS && !MACH_SAMC21
        select CANSERIAL
    config ATSAMD_MMENU_CANBUS_PB15_PB14
        bool "CAN bus (on PB15/PB14)"
        depends on HAVE_SAMD_CANBUS
        select CANSERIAL
    config ATSAMD_USBCANBUS
        bool "USB to CAN bus bridge"
        depends on HAVE_SAMD_CANBUS && HAVE_SAMD_USB
        select USBCANBUS
endchoice
choice
    prompt "CAN bus interface" if USBCANBUS
    config ATSAMD_CMENU_CANBUS_PA23_PA22
        bool "CAN bus (on PA23/PA22)"
    config ATSAMD_CMENU_CANBUS_PB13_PB12
        bool "CAN bus (on PB13/PB12)"
    config ATSAMD_CMENU_CANBUS_PB15_PB14
        bool "CAN bus (on PB15/PB14)"
endchoice

config ATSAMD_CANBUS_PA23_PA22
    bool
    default y if ATSAMD_MMENU_CANBUS_PA23_PA22 || ATSAMD_CMENU_CANBUS_PA23_PA22
config ATSAMD_CANBUS_PA25_PA24
    bool
    default y if ATSAMD_MMENU_CANBUS_PA25_PA24
config ATSAMD_CANBUS_PB11_PB10
    bool
    default y if ATSAMD_MMENU_CANBUS_PB11_PB10
config ATSAMD_CANBUS_PB13_PB12
    bool
    default y if ATSAMD_MMENU_CANBUS_PB13_PB12 || ATSAMD_CMENU_CANBUS_PB13_PB12
config ATSAMD_CANBUS_PB15_PB14
    bool
    default y if ATSAMD_MMENU_CANBUS_PB15_PB14 || ATSAMD_CMENU_CANBUS_PB15_PB14

endif
```

## src/avr/Kconfig
```kconfig
# Kconfig settings for AVR processors

if MACH_AVR

config AVR_SELECT
    bool
    default y
    select HAVE_GPIO
    select HAVE_GPIO_ADC
    select HAVE_GPIO_SPI
    select HAVE_GPIO_I2C
    select HAVE_GPIO_HARD_PWM
    select HAVE_GPIO_BITBANGING if !MACH_atmega168

config STEP_DELAY
    default -1

config BOARD_DIRECTORY
    string
    default "avr"

choice
    prompt "Processor model"
    config MACH_atmega2560
        bool "atmega2560"
    config MACH_atmega1280
        bool "atmega1280"
    config MACH_at90usb1286
        bool "at90usb1286"
    config MACH_at90usb646
        bool "at90usb646"
    config MACH_atmega32u4
        bool "atmega32u4"
    config MACH_atmega1284p
        bool "atmega1284p"
    config MACH_atmega644p
        bool "atmega644p"
    config MACH_atmega328p
        bool "atmega328p"
    config MACH_atmega328
        bool "atmega328"
    config MACH_atmega168
        bool "atmega168"
endchoice

config MCU
    string
    default "atmega168" if MACH_atmega168
    default "atmega328" if MACH_atmega328
    default "atmega328p" if MACH_atmega328p
    default "atmega1284p" if MACH_atmega1284p
    default "atmega644p" if MACH_atmega644p
    default "at90usb1286" if MACH_at90usb1286
    default "at90usb646" if MACH_at90usb646
    default "atmega32u4" if MACH_atmega32u4
    default "atmega1280" if MACH_atmega1280
    default "atmega2560" if MACH_atmega2560

config AVRDUDE_PROTOCOL
    string
    default "wiring" if MACH_atmega2560
    default "avr109" if MACH_at90usb1286 || MACH_at90usb646 || MACH_atmega32u4
    default "arduino"

choice
    prompt "Processor speed" if LOW_LEVEL_OPTIONS
    config AVR_FREQ_20000000
        bool "20Mhz"
        depends on MACH_atmega168 || MACH_atmega328 || MACH_atmega328p || MACH_atmega644p || MACH_atmega1284p
    config AVR_FREQ_16000000
        bool "16Mhz"
    config AVR_FREQ_8000000
        bool "8Mhz"
endchoice

config CLOCK_FREQ
    int
    default 8000000 if AVR_FREQ_8000000
    default 20000000 if AVR_FREQ_20000000
    default 16000000

config CLEAR_PRESCALER
    bool "Manually clear the CPU prescaler field at startup" if LOW_LEVEL_OPTIONS
    depends on MACH_at90usb1286 || MACH_at90usb646 || MACH_atmega32u4
    default y
    help
         Some AVR chips ship with a "clock prescaler" that causes the
         chip to run at 1/8th speed. Enable this setting to clear the
         prescaler field at startup which will cause the chip to run
         without a clock divisor.

config AVR_CLKPR
    int
    default 0 if CLEAR_PRESCALER
    default -1

config AVR_STACK_SIZE
    int
    default 256

config AVR_WATCHDOG
    bool
    default y
config USBSERIAL
    bool "Use USB for communication (instead of serial)"
    depends on MACH_at90usb1286 || MACH_at90usb646 || MACH_atmega32u4
    default y
config SERIAL
    depends on !USBSERIAL
    bool
    default y
choice
    depends on SERIAL
    prompt "Serial Port" if LOW_LEVEL_OPTIONS && (MACH_atmega2560 || MACH_atmega1280 || MACH_atmega644p || MACH_atmega1284p)
    help
        Select the serial device to use on the AVR chip. This is
        almost always UART0.
    config AVR_SERIAL_UART0
        bool "UART0"
    config AVR_SERIAL_UART1
        bool "UART1"
    config AVR_SERIAL_UART2
        bool "UART2" if MACH_atmega2560 || MACH_atmega1280
    config AVR_SERIAL_UART3
        bool "UART3" if MACH_atmega2560 || MACH_atmega1280
endchoice
config SERIAL_BAUD_U2X
    depends on SERIAL && !SIMULAVR
    bool
    default y

config SERIAL_PORT
    int
    default 3 if AVR_SERIAL_UART3
    default 2 if AVR_SERIAL_UART2
    default 1 if MACH_at90usb1286 || MACH_at90usb646 || MACH_atmega32u4 || AVR_SERIAL_UART1
    default 0

config SIMULAVR
    depends on MACH_atmega168 || MACH_atmega328 || MACH_atmega328p || MACH_atmega644p || MACH_atmega1284p
    bool "Compile for simulavr software emulation" if LOW_LEVEL_OPTIONS
    default n
    help
         Compile the code to run on simulavr software emulation
         instead of for real hardware. This disables support for "U2X
         baud" mode which is not supported on simulavr.

         If unsure, select "N".

endif
```

## src/avr/t5uid1/Kconfig
```kconfig
# Kconfig T5UID1 settings for AVR processors

config T5UID1_SERIAL
    depends on USBSERIAL || MACH_atmega2560 || MACH_atmega1280 || MACH_atmega644p || MACH_atmega1284p
    bool "Enable DGUS T5UID1 screen"
    default n

choice
    depends on T5UID1_SERIAL
    prompt "Screen Serial Port" if LOW_LEVEL_OPTIONS && (MACH_atmega2560 || MACH_atmega1280 || MACH_atmega644p || MACH_atmega1284p)
    default AVR_T5UID1_SERIAL_UART2 if !AVR_SERIAL_UART2 && (MACH_atmega2560 || MACH_atmega1280)
    default AVR_T5UID1_SERIAL_UART0 if !AVR_SERIAL_UART0
    default AVR_T5UID1_SERIAL_UART1
    help
        Select the serial device to use for the touchscreen.
    config AVR_T5UID1_SERIAL_UART0
        bool "UART0" if !AVR_SERIAL_UART0
    config AVR_T5UID1_SERIAL_UART1
        bool "UART1" if !AVR_SERIAL_UART1
    config AVR_T5UID1_SERIAL_UART2
        bool "UART2" if !AVR_SERIAL_UART2 && (MACH_atmega2560 || MACH_atmega1280)
    config AVR_T5UID1_SERIAL_UART3
        bool "UART3" if !AVR_SERIAL_UART3 && (MACH_atmega2560 || MACH_atmega1280)
endchoice

config T5UID1_SERIAL_PORT
    depends on T5UID1_SERIAL
    int
    default 3 if AVR_T5UID1_SERIAL_UART3
    default 2 if AVR_T5UID1_SERIAL_UART2
    default 1 if AVR_T5UID1_SERIAL_UART1
    default 0 if AVR_T5UID1_SERIAL_UART0
    default 2 if !AVR_SERIAL_UART2 && (MACH_atmega2560 || MACH_atmega1280)
    default 0 if !AVR_SERIAL_UART0
    default 1
```

## src/configs/K1_bed0_110_G21_defconfig
```kconfig
CONFIG_BOARD_INFO_CONFIGURE=y

#
# Board Configure
#
# CONFIG_MAIN_MCU_BOARD is not set
# CONFIG_NOZZLE_MCU_BOARD is not set
CONFIG_BED_MCU_BOARD=y
CONFIG_MCU_BOARD_ID=0
CONFIG_MCU_BOARD_HW_VER=110
CONFIG_MCU_BOARD_FW_VER=004
CONFIG_MCU_BOARD_FW_RESERVED=000
# end of Board Configure

CONFIG_LOW_LEVEL_OPTIONS=y
# CONFIG_MACH_AVR is not set
# CONFIG_MACH_ATSAM is not set
# CONFIG_MACH_ATSAMD is not set
# CONFIG_MACH_LPC176X is not set
# CONFIG_MACH_STM32 is not set
# CONFIG_MACH_RP2040 is not set
# CONFIG_MACH_AT32 is not set
CONFIG_MACH_GD32=y
# CONFIG_MACH_PRU is not set
# CONFIG_MACH_LINUX is not set
# CONFIG_MACH_SIMU is not set
CONFIG_BOARD_DIRECTORY="gd32"
CONFIG_MCU="gd32e230x8"
CONFIG_CLOCK_FREQ=72000000
CONFIG_SERIAL=y
CONFIG_FLASH_SIZE=0x00010000
CONFIG_FLASH_BOOT_ADDRESS=0x8000000
CONFIG_RAM_START=0x20000000
CONFIG_RAM_SIZE=0x2000
CONFIG_STACK_SIZE=512
CONFIG_FLASH_APPLICATION_ADDRESS=0x8003000
CONFIG_MCU_TYPE="21"
CONFIG_GD32_SELECT=y
# CONFIG_MACH_GD32F303XB is not set
# CONFIG_MACH_GD32F303XC is not set
# CONFIG_MACH_GD32F303XE is not set
# CONFIG_MACH_GD32F303XG is not set
# CONFIG_MACH_GD32F303XI is not set
# CONFIG_MACH_GD32F303XK is not set
# CONFIG_MACH_GD32F305XB is not set
# CONFIG_MACH_GD32F305XC is not set
# CONFIG_MACH_GD32F305XE is not set
# CONFIG_MACH_GD32F305XG is not set
# CONFIG_MACH_GD32F307XC is not set
# CONFIG_MACH_GD32F307XE is not set
# CONFIG_MACH_GD32F307XG is not set
# CONFIG_MACH_GD32E230X6 is not set
CONFIG_MACH_GD32E230X8=y
CONFIG_MACH_GD32E23X=y
# CONFIG_GD32_FLASH_START_0000 is not set
CONFIG_GD32_FLASH_START_3000=y
CONFIG_GD32_SERIAL_USART0_PA9_PA10=y
# CONFIG_GD32_SERIAL_USART1_PA2_PA3 is not set
# CONFIG_GD32_USB is not set
CONFIG_MCU_MENU="G"
CONFIG_SERIAL_BAUD=230400
CONFIG_USB_VENDOR_ID=0x1d50
CONFIG_USB_DEVICE_ID=0x614e
CONFIG_USB_SERIAL_NUMBER="12345"
CONFIG_CANBUS_FREQUENCY=500000
CONFIG_MACH_CREALITY_OTHERS=y
# CONFIG_MACH_CREALITY_CR_10_SMART is not set
CONFIG_INITIAL_PINS=""
CONFIG_BUILD_MACHINE_UID=""
CONFIG_HAVE_GPIO=y
CONFIG_HAVE_GPIO_ADC=y
CONFIG_HAVE_PRTOUCH=y
CONFIG_HAVE_GPIO_SPI=y
CONFIG_HAVE_GPIO_BITBANGING=y
CONFIG_HAVE_STRICT_TIMING=y
CONFIG_HAVE_CHIPID=y
CONFIG_HAVE_STEPPER_BOTH_EDGE=y
CONFIG_INLINE_STEPPER_HACK=y
```
