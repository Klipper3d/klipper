## src/stm32/t5uid1/Kconfig
```kconfig
# Kconfig T5UID1 settings for STM32 processors

config STM32_SERIAL_USART1_USED
    bool
    depends on SERIAL
    default y if STM32_SERIAL_USART1 || STM32_SERIAL_USART1_ALT_PB7_PB6

config STM32_SERIAL_USART2_USED
    bool
    depends on SERIAL
    default y if STM32_SERIAL_USART2 || STM32_SERIAL_USART2_ALT_PA15_PA14 || STM32_SERIAL_USART2_ALT_PD6_PD5

config STM32_SERIAL_USART3_USED
    bool
    depends on SERIAL
    default y if STM32_SERIAL_USART3 || STM32_SERIAL_USART3_ALT_PD9_PD8

config STM32_SERIAL_UART4_USED
    bool
    depends on SERIAL
    default y if STM32_SERIAL_UART4

config T5UID1_SERIAL
    bool "Enable DGUS T5UID1 screen"
    depends on !MACH_STM32F031
    default n

config STM32_T5UID1_SERIAL_USART1
    bool
    default n

config STM32_T5UID1_SERIAL_USART2
    bool
    default n

config STM32_T5UID1_SERIAL_USART3
    bool
    default n

config STM32_T5UID1_SERIAL_UART4
    bool
    default n

choice
    depends on T5UID1_SERIAL
    prompt "Screen serial interface" if LOW_LEVEL_OPTIONS
    default STM32_T5UID1_SERIAL_USART2_PA3_PA2 if !STM32_SERIAL_USART2_USED
    default STM32_T5UID1_SERIAL_USART1_PA10_PA9
    config STM32_T5UID1_SERIAL_USART1_PA10_PA9
        bool "USART1 (on PA10/PA9)"
        depends on !STM32_SERIAL_USART1_USED
        select STM32_T5UID1_SERIAL_USART1
    config STM32_T5UID1_SERIAL_USART1_PB7_PB6
        bool "USART1 (on PB7/PB6)"
        depends on !STM32_SERIAL_USART1_USED
        select STM32_T5UID1_SERIAL_USART1
    config STM32_T5UID1_SERIAL_USART2_PA3_PA2
        bool "USART2 (on PA3/PA2)"
        depends on !STM32_SERIAL_USART2_USED
        select STM32_T5UID1_SERIAL_USART2
    config STM32_T5UID1_SERIAL_USART2_PA15_PA14
        bool "USART2 (on PA15/PA14)" if MACH_STM32F0
        depends on !STM32_SERIAL_USART2_USED
        select STM32_T5UID1_SERIAL_USART2
    config STM32_T5UID1_SERIAL_USART2_PD6_PD5
        bool "USART2 (on PD6/PD5)" if !MACH_STM32F0
        depends on !STM32_SERIAL_USART2_USED
        select STM32_T5UID1_SERIAL_USART2
    config STM32_T5UID1_SERIAL_USART3_PB11_PB10
        bool "USART3 (on PB11/PB10)" if !MACH_STM32F0 && !MACH_STM32F401
        depends on !STM32_SERIAL_USART3_USED
        select STM32_T5UID1_SERIAL_USART3
    config STM32_T5UID1_SERIAL_USART3_PD9_PD8
        bool "USART3 (on PD9/PD8)" if !MACH_STM32F0 && !MACH_STM32F401
        depends on !STM32_SERIAL_USART3_USED
        select STM32_T5UID1_SERIAL_USART3
    config STM32_T5UID1_SERIAL_UART4_PA1_PA0
        bool "UART4 (on PA1/PA0)" if MACH_STM32H7
        depends on !STM32_SERIAL_UART4_USED
        select STM32_T5UID1_SERIAL_UART4
endchoice
```

## src/stm32f0/Kconfig
```kconfig
# Kconfig settings for STM32F0 processors

if MACH_STM32F0

config STM32F0_SELECT
    bool
    default y
    select HAVE_GPIO
    select HAVE_GPIO_ADC
    select HAVE_GPIO_I2C
    select HAVE_GPIO_SPI
    select HAVE_GPIO_BITBANGING

config BOARD_DIRECTORY
    string
    default "stm32f0"

config CLOCK_FREQ
    int
    default 48000000

config CANSERIAL
    bool "Use CAN bus for communication (instead of serial)"
    default y
config SERIAL
    depends on !CANSERIAL
    bool
    default y

config SERIAL_BAUD
    int "CAN bus speed" if LOW_LEVEL_OPTIONS && CANSERIAL
    default 500000 if CANSERIAL

config DEBUG_OUT
    bool "Use debug output to UART TX pin"
    depends on CANSERIAL
    default y

config USE_LOG
    string
    default "USE_LOG" if DEBUG_OUT
    default "NO_LOG" if !DEBUG_OUT

endif
```

## src/stm32f1/Kconfig
```kconfig
# Kconfig settings for STM32F1 processors

if MACH_STM32F1

config STM32F1_SELECT
    bool
    default y
    select HAVE_GPIO
    select HAVE_GPIO_ADC
    select HAVE_GPIO_SPI
    select HAVE_GPIO_BITBANGING

config BOARD_DIRECTORY
    string
    default "stm32f1"

config CLOCK_FREQ
    int
    default 72000000

choice
    prompt "Bootloader offset"
    config STM_FLASH_START_2000
        bool "8KiB bootloader (stm32duino)"
    config STM_FLASH_START_7000
        bool "28KiB bootloader"
    config STM_FLASH_START_0000
        bool "No bootloader"
endchoice

config FLASH_START
    hex
    default 0x2000 if STM_FLASH_START_2000
    default 0x7000 if STM_FLASH_START_7000
    default 0x0000

config USBSERIAL
    bool "Use USB for communication (instead of serial)"
    default y
config SERIAL
    depends on !USBSERIAL
    bool
    default y

endif
```

## src/stm32f4/Kconfig
```kconfig
# Kconfig settings for STM32F4 processors

if MACH_STM32F4

config STM32F4_SELECT
    bool
    default y
    select HAVE_GPIO
    select HAVE_GPIO_ADC
    select HAVE_GPIO_SPI
    select HAVE_GPIO_BITBANGING

config BOARD_DIRECTORY
    string
    default "stm32f4"

choice
    prompt "Processor model"
    config MACH_STM32F405
        bool "STM32F405"
    config MACH_STM32F407
        bool "STM32F407"
    config MACH_STM32F446
        bool "STM32F446"
endchoice

config MCU
    string
    default "stm32f405" if MACH_STM32F405
    default "stm32f407" if MACH_STM32F407
    default "stm32f446" if MACH_STM32F446

config CLOCK_FREQ
    int
    default 168000000 if MACH_STM32F405 || MACH_STM32F407
    default 180000000 if MACH_STM32F446

config FLASH_SIZE
    hex
    default 0x80000 if MACH_STM32F405 || MACH_STM32F407
    default 0x80000 if MACH_STM32F446

config RAM_SIZE
    hex
    default 0x30000 if MACH_STM32F405 || MACH_STM32F407
    default 0x20000 if MACH_STM32F446

config STACK_SIZE
    int
    default 512

choice
    prompt "Clock Reference" if LOW_LEVEL_OPTIONS
    config STM32_CLOCK_REF_8M
        bool "8Mhz crystal"
    config STM32_CLOCK_REF_INTERNAL
        bool "Internal clock"
endchoice
config CLOCK_REF_8M
    bool
    default n if STM32_CLOCK_REF_INTERNAL
    default y

config SERIAL
    bool
    default y
choice
    depends on SERIAL
    prompt "Serial Port" if LOW_LEVEL_OPTIONS
    help
        Select the serial device to use.
    config STM32_SERIAL_USART1
        bool "USART1"
    config STM32_SERIAL_USART2
        bool "USART2"
    config STM32_SERIAL_USART3
        bool "USART3"
endchoice
config SERIAL_PORT
    int
    default 3 if STM32_SERIAL_USART3
    default 2 if STM32_SERIAL_USART2
    default 1

endif
```
