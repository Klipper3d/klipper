## src/samd21/Kconfig
```kconfig
# Kconfig settings for SAMD21 processors

if MACH_SAMD21

config SAMD_SELECT
    bool
    default y
    select HAVE_GPIO
    select HAVE_GPIO_I2C
    select HAVE_GPIO_SPI
    select HAVE_GPIO_BITBANGING

config BOARD_DIRECTORY
    string
    default "samd21"

config CLOCK_FREQ
    int
    default 48000000

choice
    prompt "Bootloader offset"
    config FLASH_START_0000
        bool "No bootloader"
    config FLASH_START_2000
        bool "8KiB bootloader (Arduino Zero)"
    config FLASH_START_4000
        bool "16KiB bootloader (Arduino M0)"
endchoice

config FLASH_START
    hex
    default 0x4000 if FLASH_START_4000
    default 0x2000 if FLASH_START_2000
    default 0x0000

config USBSERIAL
    bool "Use USB for communication (instead of serial)"
    default y
config SERIAL
    depends on !USBSERIAL
    bool
    default y
config SERIAL_BAUD
    depends on SERIAL
    int "Baud rate for serial port"
    default 250000

endif
```

## src/simulator/Kconfig
```kconfig
# Kconfig settings for compiling and running the firmware on the host
# processor for simulation purposes.

if MACH_SIMU

config BOARD_DIRECTORY
    string
    default "simulator"

config SIMULATOR_SELECT
    bool
    default y
    select HAVE_GPIO
    select HAVE_GPIO_ADC
    select HAVE_GPIO_SPI
    select HAVE_GPIO_HARD_PWM

config SERIAL
    default y

config CLOCK_FREQ
    int
    default 20000000

endif
```
